#include <dt-bindings/zmk/matrix.h>

/ {
    kscan0: kscan0 {
        compatible = "zmk,kscan-gpio-matrix";
        diode-direction = "col2row";
        wakeup-source;

        row-gpios
            = <&gpio1 11 (GPIO_ACTIVE_HIGH | GPIO_PULL_DOWN)>
            , <&gpio1 13 (GPIO_ACTIVE_HIGH | GPIO_PULL_DOWN)>
            , <&gpio0 02 (GPIO_ACTIVE_HIGH | GPIO_PULL_DOWN)>
            , <&gpio0 29 (GPIO_ACTIVE_HIGH | GPIO_PULL_DOWN)>
            , <&gpio0 31 (GPIO_ACTIVE_HIGH | GPIO_PULL_DOWN)>
            ;

        col-gpios
            = <&gpio0 06 (GPIO_ACTIVE_HIGH | GPIO_PULL_UP)>
            , <&gpio0 08 (GPIO_ACTIVE_HIGH | GPIO_PULL_UP)>
            , <&gpio0 17 (GPIO_ACTIVE_HIGH | GPIO_PULL_UP)>
            , <&gpio0 20 (GPIO_ACTIVE_HIGH | GPIO_PULL_UP)>
            , <&gpio0 22 (GPIO_ACTIVE_HIGH | GPIO_PULL_UP)>
            , <&gpio0 24 (GPIO_ACTIVE_HIGH | GPIO_PULL_UP)>
            , <&gpio1 00 (GPIO_ACTIVE_HIGH | GPIO_PULL_UP)>
            , <&gpio0 11 (GPIO_ACTIVE_HIGH | GPIO_PULL_UP)>
            , <&gpio1 04 (GPIO_ACTIVE_HIGH | GPIO_PULL_UP)>
            , <&gpio1 06 (GPIO_ACTIVE_HIGH | GPIO_PULL_UP)>
            , <&gpio1 01 (GPIO_ACTIVE_HIGH | GPIO_PULL_UP)>
            , <&gpio1 02 (GPIO_ACTIVE_HIGH | GPIO_PULL_UP)>
            , <&gpio1 07 (GPIO_ACTIVE_HIGH | GPIO_PULL_UP)>
            , <&gpio0 09 (GPIO_ACTIVE_HIGH | GPIO_PULL_UP)>
            , <&gpio0 10 (GPIO_ACTIVE_HIGH | GPIO_PULL_UP)>
            ;
    };
};